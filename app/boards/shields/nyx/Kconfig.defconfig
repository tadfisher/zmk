## app/boards/shields/nyx/Kconfig.defconfig
```kconfig
if SHIELD_NYX_LEFT

config ZMK_KEYBOARD_NAME
	default "Nyx Left"

config ZMK_SPLIT_BLE_ROLE_CENTRAL
	default y

endif


if SHIELD_NYX_RIGHT

config ZMK_KEYBOARD_NAME
	default "Nyx Right"

config USB
	default y

endif

if SHIELD_NYX_LEFT || SHIELD_NYX_RIGHT

config ZMK_SPLIT
	default y

endif
```
